## conf/machine/cl-som-imx6ul.conf
```bitbake
#@TYPE: Machine
#@NAME: CompuLab CM-FX6
#@SOC: i.MX6 UL
#@DESCRIPTION: Machine configuration for CompuLab CL-SOM-iMX6UL machines
#@MAINTAINER: Valentin Raevsky <valentin@compulab.co.il>

include conf/machine/include/imx-base.inc
include conf/machine/include/tune-cortexa7.inc
include conf/machine/include/imx6ul-common.inc

SOC_FAMILY = "mx6:mx6ul"

PREFERRED_PROVIDER_u-boot_mx6ul = "u-boot-compulab"
PREFERRED_PROVIDER_virtual/kernel_mx6ul = "linux-compulab"

UBOOT_MACHINE ?= "cl_som_imx6ul_defconfig"

KERNEL_DEVICETREE = "imx6ul-cl-som-imx6ul.dtb imx6ul-cl-som-imx6ul-wilink.dtb"
KERNEL_DEVICETREE += "imx6ul-sbc-imx6ul.dtb imx6ul-sbc-imx6ul-wilink.dtb"

MACHINE_FEATURES += "alsa bluetooth serial usbhost wifi"

SERIAL_CONSOLE = "115200 ttymxc2"
```
